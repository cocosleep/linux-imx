/*
 * Copyright 2019 NXP
 *
 * This program is free software; you can redistribute it and/or
 * modify it under the terms of the GNU General Public License
 * as published by the Free Software Foundation; either version 2
 * of the License, or (at your option) any later version.
 */

 /dts-v1/;

 #include "imx6ull.dtsi"
 #include "imx6ull-14x14-alpha.dtsi"
 
 / {
	 model = "Alpha i.MX6 ULL 14x14 ALPHA Board";
	 compatible = "alpha,imx6ull-14x14-alpha", "fsl,imx6ull-14x14-evk", "fsl,imx6ull";
 };
 
 &clks {
	 assigned-clocks = <&clks IMX6UL_CLK_PLL3_PFD2>,
			   <&clks IMX6UL_CLK_PLL4_AUDIO_DIV>;
	 assigned-clock-rates = <320000000>, <786432000>;
 };
